## boards/arm/imxrt/frdm-imxrt1186/Kconfig
```kconfig
#
# SPDX-License-Identifier: Apache-2.0
#

if ARCH_BOARD_FRDM_IMXRT1186

config FRDM_IMXRT1186_DTCM
	bool
	default y

endif
```

## boards/arm/imxrt/imxrt1180-evk/Kconfig
```kconfig
#
# SPDX-License-Identifier: Apache-2.0
#

if ARCH_BOARD_IMXRT1180_EVK

config IMXRT1180_EVK_DTCM
	bool
	default y

config IMXRT1180_EVK_OCRAM_TEXT
	bool "Use split ITCM/OCRAM layout"
	default n
	---help---
		Place vectors and executable sections in ITCM, with read-only and
		writable sections in OCRAM.  This layout is intended for debugger-loaded
		images where CM33 can read and write OCRAM but OCRAM instruction fetches
		are blocked by the current ELE/TRDC debug handoff.

endif
```

## boards/arm/imxrt/imxrt1180-evk/configs/netnsh/defconfig
```kconfig
#
# SPDX-License-Identifier: Apache-2.0
#

# CONFIG_ARCH_LEDS is not set
# CONFIG_ARCH_RAMFUNCS is not set
# CONFIG_NSH_DISABLE_DATE is not set
# CONFIG_NSH_DISABLE_MB is not set
# CONFIG_NSH_DISABLE_MH is not set
# CONFIG_NSH_DISABLE_MW is not set
CONFIG_ARCH="arm"
CONFIG_ARCH_BOARD="imxrt1180-evk"
CONFIG_ARCH_BOARD_IMXRT1180_EVK=y
CONFIG_ARCH_CHIP="imxrt"
CONFIG_ARCH_CHIP_IMXRT=y
CONFIG_ARCH_CHIP_MIMXRT1189=y
CONFIG_ARCH_STACKDUMP=y
CONFIG_BINFMT_DISABLE=y
CONFIG_BOARD_LATE_INITIALIZE=y
CONFIG_BOARD_LOOPSPERMSEC=24000
CONFIG_BOOT_RUNFROMISRAM=y
CONFIG_BUILTIN=y
CONFIG_DEBUG_FEATURES=y
CONFIG_DEBUG_NET=y
CONFIG_DEBUG_NET_ERROR=y
CONFIG_DEBUG_NET_INFO=y
CONFIG_IDLETHREAD_STACKSIZE=2048
CONFIG_IMXRT_NETC=y
CONFIG_IMXRT_LPUART1=y
CONFIG_IMXRT1180_EVK_OCRAM_TEXT=y
CONFIG_INIT_ENTRYPOINT="nsh_main"
CONFIG_INTELHEX_BINARY=y
CONFIG_LIBC_LOCALTIME=y
CONFIG_LINE_MAX=64
CONFIG_LPUART1_BAUD=115200
CONFIG_LPUART1_SERIAL_CONSOLE=y
CONFIG_NET=y
CONFIG_NET_BINDTODEVICE=y
CONFIG_NETDEV_LATEINIT=y
CONFIG_NET_ICMP_SOCKET=y
CONFIG_NET_SOCKOPTS=y
CONFIG_NET_UDP=y
CONFIG_NSH_BUILTIN_APPS=y
CONFIG_NSH_FILEIOSIZE=512
CONFIG_NSH_READLINE=y
CONFIG_RAM_SIZE=524288
CONFIG_RAM_START=0x20480000
CONFIG_SCHED_BACKTRACE=y
CONFIG_SCHED_LPWORK=y
CONFIG_START_DAY=15
CONFIG_START_MONTH=8
CONFIG_SYSTEM_NSH=y
CONFIG_SYSTEM_PING=y
```
